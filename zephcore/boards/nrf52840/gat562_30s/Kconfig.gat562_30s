## zephcore/boards/rp2040/waveshare_rp2040_lora/board.yml
```yaml
board:
  name: waveshare_rp2040_lora
  full_name: Waveshare RP2040-LoRa (SX1262)
  vendor: waveshare
  socs:
    - name: rp2040
```

## zephcore/boards/rp2040/waveshare_rp2040_lora/waveshare_rp2040_lora_defconfig
```kconfig
# SPDX-License-Identifier: MIT
# Waveshare RP2040-LoRa default configuration

CONFIG_ARM_MPU=y
CONFIG_GPIO=y
CONFIG_PINCTRL=y
CONFIG_SPI=y
CONFIG_RESET=y
CONFIG_CLOCK_CONTROL=y

CONFIG_SERIAL=y
CONFIG_CONSOLE=y
CONFIG_UART_CONSOLE=y
CONFIG_UART_LINE_CTRL=y

CONFIG_USE_DT_CODE_PARTITION=y
CONFIG_BUILD_OUTPUT_UF2=y
CONFIG_BUILD_OUTPUT_HEX=y
```

## zephcore/dts/bindings/entropy/zephcore,rp2040-rosc-entropy.yaml
```yaml
# Copyright 2026 ZephCore
# SPDX-License-Identifier: MIT

description: |
  RP2040 ring-oscillator entropy source (ROSC RANDOMBIT register).

  The RP2040 has no hardware RNG and Zephyr ships an entropy driver only for the
  RP2350. This node registers adapters/rng/entropy_rp2040_rosc.c as the
  zephyr,entropy device. The register block is fixed in the SoC, so the node has
  no properties.

compatible: "zephcore,rp2040-rosc-entropy"

include: base.yaml
```
